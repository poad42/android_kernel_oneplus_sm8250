## drivers/oplus/Kconfig
```kconfig
source "drivers/oneplus/vl53L1/Kconfig"

#ifdef OPLUS_FEATURE_CHG_BASIC
config OPLUS_SM8250_CHARGER
	tristate "OPLUS SM8150 charger driver"
	depends on MFD_SPMI_PMIC
	help
	  Enables support for the oplus charging framework

config OPLUS_SM7250R_CHARGER
	tristate "OPLUS SM7250R charger driver"
	depends on MFD_SPMI_PMIC
	help
	  Enables support for the oplus charging framework

config OPLUS_CALL_MODE_SUPPORT
	bool "OPLUS call mode support"
	help
	  Say Y to include support

config OPLUS_SMART_CHARGER_SUPPORT
	bool "OPLUS smart charger support"
	help
	  Say Y to include support

config OPLUS_CHARGER_WIRELESS_PEN
	bool "OPLUS charger wireless pen"
	help
	  Say Y to include support

source "drivers/oplus/power/Kconfig"
#endif

source "drivers/oplus/aw8697_haptic/Kconfig"

#ifdef OPLUS_FEATURE_TP_BASIC
obj-$(CONFIG_TOUCHPANEL_OPLUS) += oplus_touchscreen/
obj-$(CONFIG_TOUCHPANEL_OPLUS) += touch.o
#endif

source "drivers/input/oplus_fp_drivers/Kconfig"
```
